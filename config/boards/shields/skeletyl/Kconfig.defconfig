## config/boards/shields/skeletyl/Kconfig.defconfig
```kconfig
config ZMK_SPLIT
    default y

if SHIELD_SKELETYL_CENTRAL

config ZMK_KEYBOARD_NAME
    default "Skeletyl"

config ZMK_SPLIT_ROLE_CENTRAL
    default y

endif
```

## config/boards/shields/skeletyl/Kconfig.shield
```kconfig
# Copyright (c) 2024 Casey Webster, Lau Kar Rui, Dennis Jusufovic
# SPDX-License-Identifier: MIT

config SHIELD_SKELETYL_LEFT
	def_bool $(shields_list_contains,skeletyl_left)

config SHIELD_SKELETYL_RIGHT
	def_bool $(shields_list_contains,skeletyl_right)

config SHIELD_SKELETYL_CENTRAL
	def_bool $(shields_list_contains,skeletyl_central)
```
